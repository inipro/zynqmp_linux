## petalinux/meta-inipro/conf/layer.conf
```bitbake
# We have a conf and classes directory, add to BBPATH
BBPATH .= ":${LAYERDIR}"

# We have recipes-* directories, add to BBFILES
BBFILES += "${LAYERDIR}/recipes-*/*/*.bb \
	${LAYERDIR}/recipes-*/*/*.bbappend"

BBFILE_COLLECTIONS += "meta-inipro"
BBFILE_PATTERN_meta-inipro = "^${LAYERDIR}/"
BBFILE_PRIORITY_meta-inipro = "7"
LAYERSERIES_COMPAT_meta-inipro = "thud"
```
